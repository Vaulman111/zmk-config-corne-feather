/* Corne keymap - ZMK v0.3 format */

/*
 * Layout: 6x4 corne + center columns
 * Left side: 6 cols (0-5), Right side: 6 cols (6-11)
 * Layers: base(0), raise(1), lower(2), adjust(3)
 */

#include <zap.sh>

&v3_col 18 KC_ESC    KC_Q    KC_W    KC_E    KC_R    KC_T    KC_Y    KC_U    KC_I    KC_O    KC_P    KC_BSPC
&v3_col 21 KC_TAB    KC_A    KC_S    KC_D    KC_F    KC_G    KC_H    KC_J    KC_K    KC_L    KC_SLSH KC_ENT
&v3_col 24 KC_LSFT   KC_Z    KC_X    KC_C    KC_V    KC_B    KC_N    KC_M    KC_COMM KC_DOT  KC_SLSH KC_RSFT
&v3_col 27 KC_LGUI   KC_LCTL KC_APP  KC_SPC  KC_SPC  KC_SPC  KC_SPC  KC_SPC  KC_RGUI KC_LALT KC_LAYER KC_DEL
