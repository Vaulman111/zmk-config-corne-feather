/*
 * Copyright (c) 2024 Vosk Labs
 *
 * SPDX-License-Identifier: MIT
 */

/* Feather nRF52840 GPIO pin mapping for Corne */

/ {
    chosen {
        zmk,kscan = &kscan0;
    };

    kscan0: kscan {
        row-gpios
            = <&pro_micro 26 (GPIO_ACTIVE_HIGH | GPIO_PULL_DOWN)>
            , <&pro_micro 8 (GPIO_ACTIVE_HIGH | GPIO_PULL_DOWN)>
            , <&pro_micro 7 (GPIO_ACTIVE_HIGH | GPIO_PULL_DOWN)>
            , <&pro_micro 27 (GPIO_ACTIVE_HIGH | GPIO_PULL_DOWN)>
            ;

        col-gpios
            = <&pro_micro 2 GPIO_ACTIVE_HIGH>
            , <&pro_micro 3 GPIO_ACTIVE_HIGH>
            , <&pro_micro 4 GPIO_ACTIVE_HIGH>
            , <&pro_micro 5 GPIO_ACTIVE_HIGH>
            , <&pro_micro 28 GPIO_ACTIVE_HIGH>
            , <&pro_micro 30 GPIO_ACTIVE_HIGH>
            ;
    };
};
