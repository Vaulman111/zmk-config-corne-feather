/ {
    chosen {
        zmk,kscan = &kscan0;
    };

    kscan0: kscan {
        compatible = "zmk,kscan-gpio-matrix";
        label = "KSCAN_RIGHT";
        row-gpios = <&gpio0 26 GPIO_ACTIVE_HIGH>,
                    <&gpio1 8  GPIO_ACTIVE_HIGH>,
                    <&gpio0 7  GPIO_ACTIVE_HIGH>,
                    <&gpio0 27 GPIO_ACTIVE_HIGH>;
        col-gpios = <&gpio0 2  GPIO_ACTIVE_HIGH>,
                    <&gpio0 3  GPIO_ACTIVE_HIGH>,
                    <&gpio0 4  GPIO_ACTIVE_HIGH>,
                    <&gpio0 5  GPIO_ACTIVE_HIGH>,
                    <&gpio0 28 GPIO_ACTIVE_HIGH>,
                    <&gpio0 30 GPIO_ACTIVE_HIGH>;
        diode-direction = "col2row";
        debounce-press-ms = <5>;
        debounce-release-ms = <5>;
        wakeup-source;
    };
};
