#include "corne-base.dtsi"

&keymap_right {
    layer_default: default {
        keys = <
            &kp Y &kp U &kp I &kp O &kp P &kp K
            &kp H &kp J &kp K &kp L &kp_SEM &kp_ENT
            &kp_N &kp_M &kp_COM &kp_DOT &kp_SLSH &kp_SCLN
            &kp_SPC &kp_SLSH &kp_BSLS &kp_RGUI &kp_RCTL
        >;
    };
    layer_fn: fn_layer {
        keys = <
            &kp_F6 &kp_F6 &kp_F6 &kp_F6 &kp_F6 &kp_FNL
            &kp_BSPC &kp_RALT &kp_RGUI &kp_LSFT &kp_TAB &kp_BSPC
            &kp_DOT &kp_FNL &kp_FNL &kp_FNL &kp_FNL &kp_ENT
            &kp_ENT &kp_RALT &kp_RGUI &kp_LSFT &kp_SPC
        >;
    };
    layer_nav: nav_layer {
        keys = <
            &kp_F6 &kp_F6 &kp_F6 &kp_FNL &kp_FNL &kp_F6
            &kp_TAB &kp_RALT &kp_RGUI &kp_LSFT &kp_TAB &kp_BSPC
            &kp_DOT &kp_FNL &kp_FNL &kp_FNL &kp_FNL &kp_ENT
            &kp_ENT &kp_RALT &kp_RGUI &kp_LSFT &kp_SPC
        >;
    };
};
