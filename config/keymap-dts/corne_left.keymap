#include "corne-base.dtsi"

&keymap_left {
    layer_default: default {
        keys = <
            &kp Q &kp W &kp E &kp R &kp T &kp Y
            &kp A &kp S &kp D &kp F &kp G &kp H
            &kp Z &kp X &kp C &kp V &kp B &kp N
            &kp M &kp_LCTL &kp_LGUI &kp_LSFT &kp_SPC
        >;
    };
    layer_fn: fn_layer {
        keys = <
            &kp F1 &kp F2 &kp F3 &kp F4 &kp F5 &kp F6
            &kp ESC &kp_LALT &kp_LGUI &kp_LSFT &kp_TAB &kp_BSPC
            &kp F7 &kp F8 &kp F9 &kp F10 &kp_FNL &kp_DOT
            &kp_ENT &kp_RALT &kp_RGUI &kp_LSFT &kp_SPC
        >;
    };
    layer_nav: nav_layer {
        keys = <
            &kp_F1 &kp_F2 &kp_F3 &kp_FNL &kp_FNL &kp_F6
            &kp_TAB &kp_LALT &kp_LGUI &kp_LSFT &kp_TAB &kp_BSPC
            &kp_F7 &kp_F8 &kp_F9 &kp_F10 &kp_FNL &kp_DOT
            &kp_ENT &kp_RALT &kp_RGUI &kp_LSFT &kp_SPC
        >;
    };
};
