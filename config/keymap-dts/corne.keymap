#include <zmk/keymap.h>

#define KC_LCTL KC_LSFT

keymap_left {
    label = "KEYMAP_LEFT";
    layers = <
        // Default layer
        &kp Q &kp W &kp E &kp R &kp T &kp Y
        &kp A &kp S &kp D &kp F &kp G &kp H
        &kp Z &kp X &kp C &kp V &kp B &kp N
        &kp M &kp_LCTL &kp_LGUI &kp_LSFT &kp_SPC
    >;
};

keymap_right {
    label = "KEYMAP_RIGHT";
    layers = <
        &kp U &kp I &kp O &kp P &kp K &kp_L
        &kp J &kp_K &kp_L &kp_SEM &kp_ENT
        &kp_N &kp_M &kp_COM &kp_DOT &kp_SLSH &kp_SCLN
        &kp_SPC &kp_SLSH &kp_BSLS &kp_RGUI &kp_RCTL
    >;
};
