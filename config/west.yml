## config/west.yml
```yaml
---
manifest:
  remotes:
    - name: zmkfirmware
      url-base: https://github.com/zmkfirmware
    - name: zephyrproject-rtos
      url-base: https://github.com/zephyrproject-rtos
  projects:
    - name: zephyr
      remote: zmkfirmware
      revision: v2.4.0
      import: app/west.yml
    - name: zmk
      remote: zmkfirmware
      revision: v0.3
  self:
    path: config
```
